/**
 * @file components/services/payload/camera_service/camera_service.c
 * @brief Camera Service – implementation.
 *
 * =============================================================================
 * IMPLEMENTATION NOTES
 * =============================================================================
 * - Uses esp_http_server for streaming and still image endpoints.
 * - When a still image is captured, it is stored in a temporary buffer and served.
 * - MJPEG stream is generated by continuously capturing frames and sending them
 *   as multipart/x-mixed-replace responses.
 * - All camera operations are non‑blocking and use the camera driver.
 * =============================================================================
 */

#include "camera_service.h"
#include "camera_driver.h"
#include "service_interfaces.h"
#include "command_params.h"
#include "event_types.h"
#include "esp_netif.h"
#include "mqtt_topic.h"
#include "esp_log.h"
#include "esp_http_server.h"
#include "esp_timer.h"
#include <string.h>

static const char *TAG = "CAMERA_SVC";

/* ============================================================
 * Configuration
 * ============================================================ */
#define CAMERA_HTTP_PORT        80
#define CAMERA_STREAM_BOUNDARY  "frame"
#define CAMERA_JPEG_QUALITY     20      /* 0‑63, lower = better quality */
#define CAMERA_FRAMESIZE        CAMERA_FRAMESIZE_VGA   /* 640x480 for streaming */

/* ============================================================
 * Internal state
 * ============================================================ */
static camera_handle_t s_camera = NULL;
static httpd_handle_t s_http_server = NULL;
static bool s_streaming = false;

/* ============================================================
 * Helper: publish image URL via MQTT
 * ============================================================ */
static void publish_image_url(const char *url)
{
    char topic[128];
    mqtt_topic_build(topic, sizeof(topic), "camera/response");

    char json[256];
    snprintf(json, sizeof(json), "{\"image_url\":\"%s\"}", url);

    command_param_union_t params;
    memset(&params, 0, sizeof(params));
    strlcpy(params.publish_mqtt.topic, topic, sizeof(params.publish_mqtt.topic));
    strlcpy((char*)params.publish_mqtt.payload, json, sizeof(params.publish_mqtt.payload));
    params.publish_mqtt.payload_len = strlen(json);
    params.publish_mqtt.qos = 1;
    params.publish_mqtt.retain = false;

    command_router_execute(COMMAND_PUBLISH_MQTT, &params);
    ESP_LOGI(TAG, "Published image URL: %s", url);
}

/* ============================================================
 * HTTP endpoint: /capture – capture and serve one JPEG
 * ============================================================ */
static esp_err_t capture_handler(httpd_req_t *req)
{
    const uint8_t *jpeg_buf;
    size_t jpeg_len;
    esp_err_t ret = camera_driver_capture(s_camera, &jpeg_buf, &jpeg_len);
    if (ret != ESP_OK) {
        httpd_resp_send_err(req, HTTPD_500_INTERNAL_SERVER_ERROR, "Capture failed");
        return ret;
    }

    /* Send JPEG as response */
    httpd_resp_set_type(req, "image/jpeg");
    httpd_resp_send(req, (const char *)jpeg_buf, jpeg_len);

    /* Publish URL (use the current IP address from netif) */
    /* For simplicity, we assume the server is on the same IP as the stream.
       We can get the IP from esp_netif_get_ip_info. */
    char url[128];
    snprintf(url, sizeof(url), "http://%s/capture", "192.168.1.100"); // placeholder – we should get real IP
    publish_image_url(url);
    return ESP_OK;
}

/* ============================================================
 * HTTP endpoint: /stream – MJPEG stream (multipart)
 * ============================================================ */
static esp_err_t stream_handler(httpd_req_t *req)
{
    if (!s_streaming) {
        httpd_resp_send_err(req, HTTPD_404_NOT_FOUND, "Stream not started");
        return ESP_FAIL;
    }

    httpd_resp_set_type(req, "multipart/x-mixed-replace; boundary=" CAMERA_STREAM_BOUNDARY);

    while (s_streaming) {
        const uint8_t *jpeg_buf;
        size_t jpeg_len;
        esp_err_t ret = camera_driver_get_frame(s_camera, &jpeg_buf, &jpeg_len);
        if (ret != ESP_OK) {
            vTaskDelay(pdMS_TO_TICKS(10));
            continue;
        }

        char part_header[128];
        snprintf(part_header, sizeof(part_header),
                 "--" CAMERA_STREAM_BOUNDARY "\r\n"
                 "Content-Type: image/jpeg\r\n"
                 "Content-Length: %d\r\n\r\n",
                 (int)jpeg_len);
        httpd_resp_send_chunk(req, part_header, strlen(part_header));
        httpd_resp_send_chunk(req, (const char *)jpeg_buf, jpeg_len);
        httpd_resp_send_chunk(req, "\r\n", 2);
        /* Release the frame buffer */
        /* Note: camera_driver_get_frame currently does not provide a release function.
           We'll need to add a release function in the driver. For now, we rely on the
           driver's internal buffer management (which reuses the same buffer). This is okay. */
    }
    httpd_resp_send_chunk(req, NULL, 0);
    return ESP_OK;
}

/* ============================================================
 * HTTP endpoint: /status – camera configuration
 * ============================================================ */
static esp_err_t status_handler(httpd_req_t *req)
{
    char json[128];
    snprintf(json, sizeof(json),
             "{\"streaming\":%d,\"resolution\":%d,\"quality\":%d}",
             s_streaming, CAMERA_FRAMESIZE, CAMERA_JPEG_QUALITY);
    httpd_resp_set_type(req, "application/json");
    httpd_resp_send(req, json, strlen(json));
    return ESP_OK;
}

/* ============================================================
 * Register HTTP endpoints
 * ============================================================ */
static void register_http_endpoints(httpd_handle_t server)
{
    httpd_uri_t capture_uri = {
        .uri       = "/capture",
        .method    = HTTP_GET,
        .handler   = capture_handler,
        .user_ctx  = NULL
    };
    httpd_register_uri_handler(server, &capture_uri);

    httpd_uri_t stream_uri = {
        .uri       = "/stream",
        .method    = HTTP_GET,
        .handler   = stream_handler,
        .user_ctx  = NULL
    };
    httpd_register_uri_handler(server, &stream_uri);

    httpd_uri_t status_uri = {
        .uri       = "/status",
        .method    = HTTP_GET,
        .handler   = status_handler,
        .user_ctx  = NULL
    };
    httpd_register_uri_handler(server, &status_uri);
}

/* ============================================================
 * Command handlers
 * ============================================================ */

static esp_err_t cmd_camera_start_stream(void *context, const command_param_union_t *params)
{
    (void)context; (void)params;
    if (!s_camera) return ESP_ERR_INVALID_STATE;
    if (s_streaming) return ESP_OK;

    esp_err_t ret = camera_driver_start_stream(s_camera);
    if (ret != ESP_OK) return ret;
    s_streaming = true;
    ESP_LOGI(TAG, "Streaming started");
    return ESP_OK;
}

static esp_err_t cmd_camera_stop_stream(void *context, const command_param_union_t *params)
{
    (void)context; (void)params;
    if (!s_streaming) return ESP_OK;
    s_streaming = false;
    camera_driver_stop_stream(s_camera);
    ESP_LOGI(TAG, "Streaming stopped");
    return ESP_OK;
}

static esp_err_t cmd_camera_capture(void *context, const command_param_union_t *params)
{
    (void)context; (void)params;
    if (!s_camera) return ESP_ERR_INVALID_STATE;

    const uint8_t *jpeg_buf;
    size_t jpeg_len;
    esp_err_t ret = camera_driver_capture(s_camera, &jpeg_buf, &jpeg_len);
    if (ret != ESP_OK) {
        ESP_LOGE(TAG, "Capture failed: %d", ret);
        return ret;
    }

    /* Build URL and publish via MQTT */
    char url[128];
    snprintf(url, sizeof(url), "http://%s/capture", "192.168.1.100"); // TODO: get real IP
    publish_image_url(url);

    /* Post event to core */
    event_t ev = {
        .id = EVENT_CAMERA_IMAGE_CAPTURED,
        .timestamp_us = esp_timer_get_time(),
        .source = 0,
        .data = { {0} }
    };
    strlcpy(ev.data.camera_image.url, url, sizeof(ev.data.camera_image.url));
    service_post_event(&ev);
    return ESP_OK;
}

static esp_err_t cmd_camera_set_resolution(void *context, const command_param_union_t *params)
{
    (void)context;
    if (!params) return ESP_ERR_INVALID_ARG;
    const camera_resolution_params_t *p = &params->camera_resolution;
    if (!s_camera) return ESP_ERR_INVALID_STATE;
    return camera_driver_set_resolution(s_camera, p->framesize);
}

static esp_err_t cmd_camera_set_quality(void *context, const command_param_union_t *params)
{
    (void)context;
    if (!params) return ESP_ERR_INVALID_ARG;
    const camera_quality_params_t *p = &params->camera_quality;
    if (!s_camera) return ESP_ERR_INVALID_STATE;
    return camera_driver_set_quality(s_camera, p->quality);
}



static void get_local_ip(char *ip_str, size_t len)
{
    esp_netif_t *netif = esp_netif_get_handle_from_ifkey("WIFI_STA_DEF");
    if (!netif) {
        strlcpy(ip_str, "0.0.0.0", len);
        return;
    }
    esp_netif_ip_info_t ip_info;
    if (esp_netif_get_ip_info(netif, &ip_info) == ESP_OK) {
        snprintf(ip_str, len, IPSTR, IP2STR(&ip_info.ip));
    } else {
        strlcpy(ip_str, "0.0.0.0", len);
    }
}


/* Wrappers for command router (void* params) */
static esp_err_t start_wrapper(void *context, const command_param_union_t *params)
{
    return cmd_camera_start_stream(context, params);
}
static esp_err_t stop_wrapper(void *context, const command_param_union_t *params)
{
    return cmd_camera_stop_stream(context, params);
}
static esp_err_t capture_wrapper(void *context, const command_param_union_t *params)
{
    return cmd_camera_capture(context, params);
}
static esp_err_t set_res_wrapper(void *context, const command_param_union_t *params)
{
    return cmd_camera_set_resolution(context, params);
}
static esp_err_t set_qual_wrapper(void *context, const command_param_union_t *params)
{
    return cmd_camera_set_quality(context, params);
}

/* ============================================================
 * Public API
 * ============================================================ */

esp_err_t camera_service_init(void)
{
    if (s_camera != NULL) {
        return ESP_ERR_INVALID_STATE;
    }

    /* Create camera driver */
    camera_config_t cfg = {
        .pixel_format   = CAMERA_PIXFORMAT_JPEG,
        .frame_size     = FRAMESIZE_QVGA,
        // .frame_size     = CAMERA_FRAMESIZE,
        .jpeg_quality   = CAMERA_JPEG_QUALITY,
        .fb_count       = 1,
        .grab_mode      = false,
        .fb_location    = CAMERA_FB_IN_DRAM
    };
    esp_err_t ret = camera_driver_create(&cfg, &s_camera);
    if (ret != ESP_OK) {
        ESP_LOGE(TAG, "Failed to create camera driver: %d", ret);
        return ret;
    }

    /* Start HTTP server */
    httpd_config_t http_config = HTTPD_DEFAULT_CONFIG();
    http_config.lru_purge_enable = true;
    http_config.stack_size = 8192;
    ret = httpd_start(&s_http_server, &http_config);
    if (ret != ESP_OK) {
        ESP_LOGE(TAG, "Failed to start HTTP server: %d", ret);
        camera_driver_delete(s_camera);
        s_camera = NULL;
        return ret;
    }

    register_http_endpoints(s_http_server);
    ESP_LOGI(TAG, "Camera service initialised (HTTP port %d)", CAMERA_HTTP_PORT);
    return ESP_OK;
}

esp_err_t camera_service_register_handlers(void)
{
    esp_err_t ret;
    ret = service_register_command(COMMAND_CAMERA_START_STREAM, start_wrapper, NULL);
    if (ret != ESP_OK) return ret;
    ret = service_register_command(COMMAND_CAMERA_STOP_STREAM, stop_wrapper, NULL);
    if (ret != ESP_OK) return ret;
    ret = service_register_command(COMMAND_CAMERA_CAPTURE, capture_wrapper, NULL);
    if (ret != ESP_OK) return ret;
    ret = service_register_command(COMMAND_CAMERA_SET_RESOLUTION, set_res_wrapper, NULL);
    if (ret != ESP_OK) return ret;
    ret = service_register_command(COMMAND_CAMERA_SET_QUALITY, set_qual_wrapper, NULL);
    if (ret != ESP_OK) return ret;
    ESP_LOGI(TAG, "Camera command handlers registered");
    return ESP_OK;
}

esp_err_t camera_service_start(void)
{
    /* Auto‑start streaming so you can see video immediately */
    cmd_camera_start_stream(NULL, NULL);
    ESP_LOGI(TAG, "Camera service started (streaming active)");
    return ESP_OK;
}

esp_err_t camera_service_stop(void)
{
    if (s_streaming) {
        cmd_camera_stop_stream(NULL, NULL);
    }
    if (s_http_server) {
        httpd_stop(s_http_server);
        s_http_server = NULL;
    }
    if (s_camera) {
        camera_driver_delete(s_camera);
        s_camera = NULL;
    }
    ESP_LOGI(TAG, "Camera service stopped");
    return ESP_OK;
}